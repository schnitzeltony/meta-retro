## conf/layer.conf
```bitbake
# We have a conf directory, append to BBPATH
BBPATH .= ":${LAYERDIR}"

# We have a recipes directory, add to BBFILES
BBFILES += "${LAYERDIR}/recipes*/*/*.bb"

BBFILE_COLLECTIONS += "meta-retro"
BBFILE_PATTERN_meta-retro := "^${LAYERDIR}/"
BBFILE_PRIORITY_meta-retro = "10"

LAYERDEPENDS_meta-retro = "core openembedded-layer filesystems-layer"
LAYERSERIES_COMPAT_meta-retro = "dunfell gatesgarth hardknott"
```
